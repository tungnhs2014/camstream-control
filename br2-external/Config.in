## br2-external/Config.in
```kconfig
source "$BR2_EXTERNAL_CAMSTREAM_PATH/package/camstream-capture/Config.in"
source "$BR2_EXTERNAL_CAMSTREAM_PATH/package/camstream-gst-test/Config.in"
source "$BR2_EXTERNAL_CAMSTREAM_PATH/package/camstream-video/Config.in"
```

## br2-external/package/camstream-capture/Config.in
```kconfig
config BR2_PACKAGE_CAMSTREAM_CAPTURE
	bool "camstream-capture"
	depends on BR2_INSTALL_LIBSTDCPP
	help
	  Native V4L2 diagnostic and capture utility for CamStream Control.
```

## br2-external/package/camstream-gst-test/Config.in
```kconfig
config BR2_PACKAGE_CAMSTREAM_GST_TEST
	bool "camstream-gst-test"
	depends on BR2_INSTALL_LIBSTDCPP
	depends on BR2_PACKAGE_GSTREAMER1
	depends on BR2_PACKAGE_GST1_PLUGINS_BASE_PLUGIN_VIDEOCONVERTSCALE
	depends on BR2_PACKAGE_GST1_PLUGINS_GOOD
	depends on BR2_PACKAGE_GST1_PLUGINS_GOOD_JPEG
	depends on BR2_PACKAGE_GST1_PLUGINS_GOOD_PLUGIN_V4L2
	help
	  Reusable native-GStreamer V4L2 pipeline component and finite
	  diagnostic CLI for CamStream Control.
```

## br2-external/package/camstream-service/Config.in
```kconfig
config BR2_PACKAGE_CAMSTREAM_SERVICE
	bool "camstream-service"
	depends on BR2_INSTALL_LIBSTDCPP
	depends on BR2_TOOLCHAIN_HAS_THREADS
	depends on BR2_PACKAGE_GSTREAMER1
	depends on BR2_PACKAGE_GST1_PLUGINS_BASE_PLUGIN_VIDEOCONVERTSCALE
	depends on BR2_PACKAGE_GST1_PLUGINS_GOOD
	depends on BR2_PACKAGE_GST1_PLUGINS_GOOD_JPEG
	depends on BR2_PACKAGE_GST1_PLUGINS_GOOD_PLUGIN_V4L2
	help
	  Foreground Camera Service owning the reusable native-GStreamer
	  V4L2 pipeline for CamStream Control.

comment "camstream-service needs a toolchain w/ C++, threads"
	depends on !BR2_INSTALL_LIBSTDCPP || !BR2_TOOLCHAIN_HAS_THREADS
```

## br2-external/package/camstream-video/Config.in
```kconfig
config BR2_PACKAGE_CAMSTREAM_VIDEO
	bool "camstream-video"
	depends on BR2_LINUX_KERNEL
	help
	  Build the CamStream synthetic V4L2 capture driver module.

	  The current driver provides fixed YUYV format negotiation and an
	  MMAP streaming lifecycle. Synthetic frame production is implemented
	  by a later checkpoint.
```
